## firmware/s3/src/Kconfig.projbuild
```kconfig
menu "AudioKnob"

    config AK_WIFI_SSID
        string "Fallback WiFi SSID (s3 target)"
        default ""
        help
            Optional, for development. Normally WiFi is set up on-device: with
            no saved network the S3 shows a QR code for its setup hotspot and
            captive portal, and stores what the user picks in NVS. These
            values are only used when NVS holds no network yet.

    config AK_WIFI_PASSWORD
        string "Fallback WiFi password (s3 target)"
        default ""

    config AK_LCD_PCLK_MHZ
        int "LCD QSPI clock (MHz, s3 target)"
        depends on IDF_TARGET_ESP32S3
        range 10 80
        default 80
        help
            Waveshare's firmware drives the ST77916 at 80 MHz. Drop to 40 or
            20 if the panel shows pixel noise.

    config AK_BACKLIGHT_DEFAULT_PCT
        int "Default backlight brightness (%, s3 target)"
        depends on IDF_TARGET_ESP32S3
        range 5 100
        default 40

    choice AK_AIRPLAY_RECEIVER
        prompt "AirPlay receiver (s3 target)"
        depends on IDF_TARGET_ESP32S3
        default AK_AIRPLAY2
        help
            Which AirPlay receiver the S3 runs. Both play through the same
            player and UI.

        config AK_AIRPLAY1
            bool "AirPlay 1 only (src/device/airplay/v1/)"

        config AK_AIRPLAY2
            bool "AirPlay 2 and AirPlay 1 (src/device/airplay/v2/)"
            select MBEDTLS_CHACHA20_C
            select MBEDTLS_POLY1305_C
            select MBEDTLS_CHACHAPOLY_C
            select MBEDTLS_HKDF_C
            help
                Built from shairport-sync's AirPlay 2 handling and owntone's
                pair_ap (MIT) with a PTP follower of our own. AirPlay 1
                senders share its RTSP port, as with shairport-sync. No
                FairPlay.
    endchoice

    config AK_LVGL_PERF_LOG
        bool "Benchmark LVGL rendering (s3 target)"
        depends on IDF_TARGET_ESP32S3
        default n
        help
            Redraws the whole active screen on every refresh and logs fps,
            frame time and internal RAM headroom every 5 s. For measuring
            rendering changes only: it keeps the CPU and display busy.

endmenu
```

## src/Kconfig.projbuild
```kconfig
menu "AudioKnob"

    config AK_WIFI_SSID
        string "Fallback WiFi SSID (s3 target)"
        default ""
        help
            Optional, for development. Normally WiFi is set up on-device: with
            no saved network the S3 shows a QR code for its setup hotspot and
            captive portal, and stores what the user picks in NVS. These
            values are only used when NVS holds no network yet.

    config AK_WIFI_PASSWORD
        string "Fallback WiFi password (s3 target)"
        default ""

    config AK_LCD_PCLK_MHZ
        int "LCD QSPI clock (MHz, s3 target)"
        depends on IDF_TARGET_ESP32S3
        range 10 80
        default 80
        help
            Waveshare's firmware drives the ST77916 at 80 MHz. Drop to 40 or
            20 if the panel shows pixel noise.

    config AK_BACKLIGHT_DEFAULT_PCT
        int "Default backlight brightness (%, s3 target)"
        depends on IDF_TARGET_ESP32S3
        range 5 100
        default 40

    config AK_LVGL_PERF_LOG
        bool "Benchmark LVGL rendering (s3 target)"
        depends on IDF_TARGET_ESP32S3
        default n
        help
            Redraws the whole active screen on every refresh and logs fps,
            frame time and internal RAM headroom every 5 s. For measuring
            rendering changes only: it keeps the CPU and display busy.

endmenu
```
